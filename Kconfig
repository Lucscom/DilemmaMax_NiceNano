## Kconfig
```kconfig
# Dilemma Max - eigene Build-Optionen

# maXTouch-Trackpadtreiber (frueher eigenes Modul, siehe CMakeLists.txt)
rsource "drivers/Kconfig"

config DILEMMA_MAX_GESTURE_KEYS
    bool "Trackpad-Gesten als Tastenkuerzel ausloesen"
    default y
    depends on DT_HAS_DILEMMA_INPUT_PROCESSOR_GESTURE_KEYS_ENABLED
    depends on ZMK_POINTING && (!ZMK_SPLIT || ZMK_SPLIT_ROLE_CENTRAL)
    help
      Input-Processor fuer die linke Haelfte (src/gesture_keys.c). Der Trackpad-Treiber
      meldet erkannte Gesten (Drei-Finger-Wischen, Pinch) als eigene Codes, dieser
      Processor loest dafuer die im Devicetree zugeordneten Tastenkuerzel aus.

      Die Kuerzel laufen als keycode_state_changed-Events ueber die System-Workqueue,
      nicht ueber Behaviours: Behaviours aus dem Input-Listener liessen beide Haelften
      abstuerzen (vermutlich der kleine Stack des Input-Threads auf dem Central).

config DILEMMA_MAX_RGB_SPLIT_SYNC
    bool "Underglow-Zustand vom Central an die Peripherals spiegeln"
    default y
    depends on ZMK_RGB_UNDERGLOW && ZMK_SPLIT && ZMK_SPLIT_ROLE_CENTRAL
    help
      Der Activity-State, an dem CONFIG_ZMK_RGB_UNDERGLOW_AUTO_OFF_IDLE haengt, wird
      von ZMK nicht ueber den Split-Link uebertragen. Das Central sieht die Tasten
      beider Haelften, ein Peripheral nur seine eigenen - ohne diese Option bleibt
      die rechte Haelfte also dunkel, solange man links tippt.

      Ist die Option aktiv, schickt das Central bei jedem Wechsel zwischen aktiv und
      idle und sobald sich ein Peripheral verbindet das rgb_ug-Behavior mit RGB_ON
      bzw. RGB_OFF an alle Peripherals. Auf den
      Peripherals gehoert dann CONFIG_ZMK_RGB_UNDERGLOW_AUTO_OFF_IDLE=n gesetzt,
      sonst schalten sie sich zusaetzlich selbst ab.

config DILEMMA_MAX_RGB_SPLIT_SYNC_RESYNC_SEC
    int "Abstand in Sekunden, in dem der Zustand erneut geschickt wird (0 = aus)"
    default 120
    depends on DILEMMA_MAX_RGB_SPLIT_SYNC
    help
      Faengt den Fall ab, dass ein Peripheral neu startet und dabei einen veralteten
      Underglow-Zustand aus den Settings wiederherstellt. Zwischen zwei Idle-Wechseln
      passiert sonst nichts, was das korrigieren wuerde.

      Der Wert muss ueber CONFIG_ZMK_SETTINGS_SAVE_DEBOUNCE (Default 60000 ms) liegen:
      jedes empfangene Kommando schiebt auf dem Peripheral den anstehenden Settings-
      Save nach hinten, bei einem kuerzeren Abstand wuerde der Save nie ausgefuehrt
      und z.B. eine geaenderte Helligkeit dort nicht mehr persistiert.

config DILEMMA_MAX_RGB_SLEEP_BLANK
    bool "Underglow vor dem Deep Sleep synchron loeschen"
    default y
    depends on ZMK_RGB_UNDERGLOW && ZMK_SLEEP
    help
      WS2812/SK6805 behalten ihren letzten Zustand, sobald der Controller nichts mehr
      sendet. Geht eine Haelfte mit leuchtendem Strip in sys_poweroff(), leuchtet der
      Strip weiter und zieht den Akku leer.

      Ohne CONFIG_ZMK_RGB_UNDERGLOW_AUTO_OFF_IDLE fehlt die Idle-Abschaltung, die den
      Strip sonst laengst vor dem Sleep-Timeout schwarz macht. zmk_rgb_underglow_off()
      allein genuegt nicht, weil es das Loeschen auf die Low-Prio-Workqueue schiebt,
      die vor dem Poweroff nicht mehr laeuft.

      Auf einer Seite mit aktiver Idle-Abschaltung kostet die Option nur einen
      zusaetzlichen SPI-Transfer beim Einschlafen.

config DILEMMA_MAX_RGB_SPLIT_FOLLOW
    bool "Underglow des Peripherals an die Split-Verbindung koppeln"
    default y
    depends on ZMK_RGB_UNDERGLOW && ZMK_SPLIT_BLE && !ZMK_SPLIT_ROLE_CENTRAL
    help
      Gegenstueck zu CONFIG_DILEMMA_MAX_RGB_SPLIT_SYNC auf der Peripheral-Seite.

      Weil das Peripheral nicht mehr selbst ueber sein Underglow entscheidet, bliebe
      der Strip an, sobald vom Central nichts mehr kommt - es ausgeschaltet ist, im
      Deep Sleep liegt oder ausser Reichweite. Mit dieser Option geht der Strip aus,
      wenn die Split-Verbindung wegfaellt, und bleibt nach dem Start aus. Eingeschaltet
      wird er erst durch den Zustand, den das Central nach dem Verbinden schickt.

config DILEMMA_MAX_STATUS_SCREEN
    bool "Eigenes nice!view-Layout: Akku, Verbindung, Modifier, Layer"
    default y
    depends on SHIELD_NICE_VIEW && ZMK_DISPLAY_STATUS_SCREEN_CUSTOM && !NICE_VIEW_WIDGET_STATUS
    depends on ZMK_SPLIT && ZMK_SPLIT_BLE && ZMK_SPLIT_ROLE_CENTRAL
    select ZMK_SPLIT_BLE_CENTRAL_BATTERY_LEVEL_FETCHING
    select LV_USE_CANVAS
    select LV_USE_IMG
    select LV_FONT_UNSCII_8
    select LV_FONT_MONTSERRAT_10
    select LV_FONT_MONTSERRAT_16
    select LV_FONT_MONTSERRAT_18
    help
      Ersetzt das Status-Widget des nice_view-Shields durch src/status_screen.c.
      Dafuer muss CONFIG_NICE_VIEW_WIDGET_STATUS=n gesetzt sein, sonst definieren
      beide zmk_display_status_screen(). Fehlt das, bleibt diese Option aus und das
      Display zeigt das Original-Widget.

      Den Akkustand der rechten Haelfte holt das Central per Split-BLE ab
      (CONFIG_ZMK_SPLIT_BLE_CENTRAL_BATTERY_LEVEL_FETCHING).

config DILEMMA_MAX_PERIPHERAL_CHARGE_REPORT
    bool "Ladezustand der Peripheral im Akkustand kodieren"
    default y
    depends on ZMK_SPLIT && !ZMK_SPLIT_ROLE_CENTRAL && ZMK_BATTERY_REPORTING && BT_BAS
    depends on SOC_SERIES_NRF52X
    help
      ZMK v0.3 uebertraegt von der Peripheral nur den Akkustand, nicht ob sie laedt.
      Diese Option steckt den Ladezustand in die Parittaet des gemeldeten Werts:
      ungerade = laedt. Das kostet ein Prozent Genauigkeit.

      Ob USB Strom liefert, liest src/peripheral_charge_report.c direkt an der
      VBUS-Erkennung des nRF52840 ab - CONFIG_ZMK_USB ist auf einer Peripheral nicht
      erlaubt.

      Gegenstueck ist CONFIG_DILEMMA_MAX_PERIPHERAL_CHARGE_DECODE auf dem Central.
      Beide Haelften gehoeren zusammen geflasht: ohne diese Option rechts deutet das
      Central jeden ungeraden Akkustand als "laedt".

config DILEMMA_MAX_PERIPHERAL_CHARGE_POLL_SEC
    int "Abstand in Sekunden, in dem VBUS geprueft wird"
    default 10
    depends on DILEMMA_MAX_PERIPHERAL_CHARGE_REPORT
    help
      Zwischen zwei Akku-Messungen (CONFIG_ZMK_BATTERY_REPORT_INTERVAL, Default 60 s)
      merkt sonst niemand, dass das Kabel gerade gesteckt oder gezogen wurde.

config DILEMMA_MAX_PERIPHERAL_CHARGE_DECODE
    bool "Ladezustand der Peripheral aus dem Akkustand lesen"
    default y
    depends on DILEMMA_MAX_STATUS_SCREEN
    help
      Gegenstueck zu CONFIG_DILEMMA_MAX_PERIPHERAL_CHARGE_REPORT auf dem Central.
      Aus zu lassen, solange rechts eine Firmware ohne die Kodierung laeuft.

config DILEMMA_MAX_BATTERY_FILTER
    bool "Akkustand um den Spannungseinbruch durch das Underglow bereinigen"
    default y
    depends on DT_HAS_DILEMMA_BATTERY_FILTER_ENABLED
    depends on ZMK_BATTERY_REPORTING
    help
      Treiber fuer den Knoten dilemma,battery-filter (src/battery_filter.c), der in
      dilemma_max.dtsi als zmk,battery vor dem VDDH-Sensor des nice!nano sitzt.

      ZMK misst nur, solange die Haelfte aktiv ist, also immer mit leuchtenden LEDs.
      Deren Strom drueckt die Akkuspannung, und bei 7,5 mV pro Prozent wird daraus eine
      Anzeige, die mit dem Underglow springt und viel zu frueh 0 % meldet. Der Treiber
      lernt den Einbruch aus Messungen mit und ohne Underglow und rechnet ihn heraus.

config DILEMMA_MAX_RAIL_IDLE
    bool "3,3-V-Schiene im Idle abschalten"
    default y
    depends on DT_HAS_DILEMMA_BEHAVIOR_RAIL_POWER_ENABLED
    depends on DT_HAS_ZMK_EXT_POWER_GENERIC_ENABLED
    depends on PM_DEVICE && ZMK_SLEEP
    help
      Schaltet die geschaltete 3,3-V-Schiene des nice!nano ab, sobald 30 s nichts
      eingegeben wurde (CONFIG_ZMK_IDLE_TIMEOUT), und beim naechsten Tastendruck wieder
      ein (src/rail_idle.c). An der Schiene haengen die LEDs, das nice!view und das
      Trackpad; allein der Ruhestrom der 51 LEDs liegt bei 20 bis 35 mA pro Haelfte.

      Folgen: das Display ist im Idle dunkel, und das Trackpad kann die Tastatur nicht
      mehr aufwecken. Nach einem Tastendruck braucht es etwa eine Sekunde, bis es wieder
      reagiert.

      Beide Haelften gehoeren zusammen geflasht: das Central schaltet die Schiene des
      Peripherals ueber ein eigenes Behavior.

config DILEMMA_MAX_RAIL_IDLE
    bool "3,3-V-Schiene im Idle abschalten"
    default y
    depends on DT_HAS_DILEMMA_BEHAVIOR_RAIL_POWER_ENABLED
    depends on DT_HAS_ZMK_EXT_POWER_GENERIC_ENABLED
    depends on PM_DEVICE && ZMK_SLEEP
    help
      Schaltet die geschaltete 3,3-V-Schiene des nice!nano ab, sobald 30 s nichts
      eingegeben wurde (CONFIG_ZMK_IDLE_TIMEOUT), und beim naechsten Tastendruck wieder
      ein (src/rail_idle.c). An der Schiene haengen die LEDs, das nice!view und das
      Trackpad; allein der Ruhestrom der 51 LEDs liegt bei 20 bis 35 mA pro Haelfte.

      Folgen: das Display ist im Idle dunkel, und das Trackpad kann die Tastatur nicht
      mehr aufwecken. Nach einem Tastendruck braucht es etwa eine Sekunde, bis es wieder
      reagiert.

      Beide Haelften gehoeren zusammen geflasht: das Central schaltet die Schiene des
      Peripherals ueber ein eigenes Behavior.

config DILEMMA_MAX_BATTERY_CAPACITY_MAH
    int "Kapazitaet des Akkus einer Haelfte in mAh"
    default 220
    depends on DILEMMA_MAX_BATTERY_FILTER
    help
      Fuer die Schaetzung des Ladestands am USB-Kabel: dort liegt am Messpin die
      Versorgung an und nicht der Akku, der Fortschritt wird deshalb aus Ladestrom,
      Zeit und Kapazitaet hochgerechnet.

config DILEMMA_MAX_CHARGE_CURRENT_MA
    int "Ladestrom in mA"
    default 100
    depends on DILEMMA_MAX_BATTERY_FILTER
    help
      Der Ladechip des nice!nano v2 laedt mit 100 mA.

config DILEMMA_MAX_POWER
    bool "Einstellbare Zeiten fuer Beleuchtung, 3,3-V-Schiene und Deep Sleep"
    default y
    depends on DILEMMA_MAX_RAIL_IDLE && DILEMMA_MAX_RGB_SPLIT_SYNC
    depends on ZMK_POINTING && SETTINGS
    help
      Eigene Uhr seit der letzten Eingabe auf dem Central (src/power.c), mit drei Zeiten,
      die sich zur Laufzeit aendern lassen und in den Settings liegen. Ersetzt ZMKs
      einkompilierte Zeiten: dafuer gehoeren CONFIG_ZMK_RGB_UNDERGLOW_AUTO_OFF_IDLE=n
      und ein sehr langer CONFIG_ZMK_IDLE_SLEEP_TIMEOUT gesetzt, auf beiden Haelften.

      Die rechte Haelfte wird vom Central kommandiert, auch in den Deep Sleep.

config DILEMMA_MAX_POWER_RAIL_ON_USB
    bool "3,3-V-Schiene des Centrals am USB-Kabel anlassen"
    default y
    depends on DILEMMA_MAX_POWER
    help
      Am Kabel muss nichts gespart werden, und das Display bleibt so lesbar. Mit n geht
      die Schiene auch am Kabel nach der eingestellten Zeit aus - zum Testen der
      Abschaltung, ohne auf Akku umstecken zu muessen. Der Deep Sleep bleibt am Kabel in
      jedem Fall aus.

config DILEMMA_MAX_MENU
    bool "Einstellungsmenue auf dem nice!view"
    default y
    depends on DT_HAS_DILEMMA_BEHAVIOR_MENU_ENABLED && DT_HAS_DILEMMA_BEHAVIOR_MENU_KNOB_ENABLED
    depends on DILEMMA_MAX_POWER && DILEMMA_MAX_STATUS_SCREEN
    depends on DILEMMA_MAX_INPUT_SETTINGS && DILEMMA_MAX_OS_MODE
    help
      Menue mit Untermenues fuer Stromsparen, Trackpad und Bedienung, bedient mit dem
      linken Encoder ueber das Behavior &menu (src/menu.c). Die Keymap braucht dafuer
      einen eigenen Layer, siehe DM_LAYER_MENU in dt-bindings/dilemma_max/layers.h.

config DILEMMA_MAX_OS_MODE
    bool "Mac oder Windows pro Bluetooth-Profil"
    default y
    depends on ZMK_BLE && SETTINGS && (!ZMK_SPLIT || ZMK_SPLIT_ROLE_CENTRAL)
    depends on DILEMMA_MAX_STATUS_SCREEN
    help
      Merkt sich pro Ausgang (Bluetooth-Profile und USB), ob dort ein Mac oder ein
      Windows-Rechner haengt (src/os_mode.c), einstellbar im Menue. Fuer Windows ist der
      Layer DM_LAYER_WIN der Keymap aktiv, und die Trackpad-Gesten nehmen die Kuerzel aus
      keycodes-win des gesture_keys-Knotens.

config DILEMMA_MAX_INPUT_SETTINGS
    bool "Einstellungen fuer Trackpad und Encoder"
    default y
    depends on DILEMMA_MAX_POWER && DT_HAS_DILEMMA_INPUT_PROCESSOR_PAD_TUNE_ENABLED
    depends on DT_HAS_DILEMMA_BEHAVIOR_KNOB_ENABLED
    help
      Cursor- und Scroll-Geschwindigkeit, Scroll-Richtung, Tippen und Auslaufen des
      Trackpads und die Funktion des linken Encoders, einstellbar im Menue und in den
      Settings abgelegt (src/input_settings.c). Die Geschwindigkeiten rechnet der
      Input-Processor pad_tune ein (src/pad_tune.c), der im Trackpad-Listener anstelle
      des zip_xy_scaler steht.

      Die Encoder haengen in der Keymap am Behavior &knob (src/knob.c), das die
      eingestellte Funktion ueber &kp, &msc bzw. &rgb_ug ausfuehrt.
```

## config/west.yml
```yaml
manifest:
  defaults:
    revision: v0.3
  remotes:
    - name: zmkfirmware
      url-base: https://github.com/zmkfirmware
    - name: philippkober
      url-base: https://github.com/philippkober
  projects:
    - name: zmk
      remote: zmkfirmware
      import: app/west.yml
    - name: maxtouch-zephyr-module
      remote: philippkober
      revision: main
      path: modules/maxtouch
  self:
    path: config
```

## dts/bindings/behaviors/dilemma,behavior-knob.yaml
```yaml
description: |
  Dilemma Max: Encoder mit einstellbarer Funktion (src/knob.c). param1 ist einer der Werte
  DM_KNOB_* aus dt-bindings/dilemma_max/knob.h und sagt nur, welcher Encoder wohin gedreht
  wurde; die Funktion selbst kommt aus dem Menue.

compatible: "dilemma,behavior-knob"

include: one_param.yaml
```

## dts/bindings/behaviors/dilemma,behavior-menu-knob.yaml
```yaml
description: |
  Dilemma Max: Encoder im Einstellungsmenue (src/menu_knob.c). Sensor-Behavior ohne
  Parameter fuer die sensor-bindings des MENU-Layers; drehen waehlt den Eintrag.

compatible: "dilemma,behavior-menu-knob"

include: behavior-metadata.yaml

properties:
  "#sensor-binding-cells":
    type: int
    required: true
    const: 0
```

## dts/bindings/behaviors/dilemma,behavior-menu.yaml
```yaml
description: |
  Dilemma Max: bedient das Einstellungsmenue auf dem nice!view (src/menu.c). param1 ist
  eines der Kommandos DM_MENU_* aus dt-bindings/dilemma_max/menu.h.

compatible: "dilemma,behavior-menu"

include: one_param.yaml
```

## dts/bindings/behaviors/dilemma,behavior-rail-power.yaml
```yaml
description: |
  Dilemma Max: schaltet die 3,3-V-Schiene der Haelfte, auf der es laeuft (src/rail_idle.c).
  Das Central ruft es ueber den Split-Link auf dem Peripheral auf, param1 = 1 an, 0 aus.
  Nicht fuer die Keymap gedacht.

compatible: "dilemma,behavior-rail-power"

include: one_param.yaml
```

## dts/bindings/input_processors/dilemma,input-processor-gesture-keys.yaml
```yaml
description: |
  Dilemma Max: setzt Gesten-Codes des Trackpads (dt-bindings/dilemma_max/gestures.h) in
  Tastenkuerzel um. Laeuft im Input-Listener der linken Haelfte. Das Kuerzel wird als
  keycode_state_changed-Event auf der System-Workqueue ausgeloest, nicht ueber Behaviours.

compatible: "dilemma,input-processor-gesture-keys"

include: ip_zero_param.yaml

properties:
  codes:
    type: array
    required: true
    description: Gesten-Codes (DM_GESTURE_*), die abgefangen werden
  keycodes:
    type: array
    required: true
    description: |
      Kuerzel pro Code, gleiche Reihenfolge wie codes. ZMK-Keycodes aus
      dt-bindings/zmk/keys.h, Modifier ueber LC(), LG() usw.
```

## dts/bindings/input_processors/dilemma,input-processor-pad-tune.yaml
```yaml
description: |
  Dilemma Max: skaliert Cursor- und Scroll-Events des Trackpads nach den Einstellungen aus
  dem Menue (src/pad_tune.c). Laeuft im Input-Listener der linken Haelfte anstelle des
  festen zip_xy_scaler.

compatible: "dilemma,input-processor-pad-tune"

include: ip_zero_param.yaml
```
